## config/west.yml
```yaml
manifest:
  remotes:
    - name: zmkfirmware
      url-base: https://github.com/zmkfirmware
  projects:
    - name: zmk
      remote: zmkfirmware
      revision: 9917e2f1371d5bb051bf8eb782c1297db41d742b  # main @ 2026-05-22
      import: app/west.yml
  self:
    path: config
```
